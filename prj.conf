## prj.conf
```kconfig
# Copyright 2019 The TensorFlow Authors. All Rights Reserved.
#
# Licensed under the Apache License, Version 2.0 (the "License");
# you may not use this file except in compliance with the License.
# You may obtain a copy of the License at
#
#    http://www.apache.org/licenses/LICENSE-2.0
#
# Unless required by applicable law or agreed to in writing, software
# distributed under the License is distributed on an "AS IS" BASIS,
# WITHOUT WARRANTIES OR CONDITIONS OF ANY KIND, either express or implied.
# See the License for the specific language governing permissions and
# limitations under the License.
# ==============================================================================s
CONFIG_CPP=y
CONFIG_STD_CPP17=y
CONFIG_TENSORFLOW_LITE_MICRO=y
CONFIG_MAIN_STACK_SIZE=2048
CONFIG_REQUIRES_FLOAT_PRINTF=y
CONFIG_GPIO=y
```

## cmsis_nn.conf
```kconfig
# Stage 2: swap TFLM reference kernels for Arm CMSIS-NN optimized kernels.
CONFIG_TENSORFLOW_LITE_MICRO_CMSIS_NN_KERNELS=y
```

## src/main.c
```c
/*
 * Copyright 2020 The TensorFlow Authors. All Rights Reserved.
 *
 * Licensed under the Apache License, Version 2.0 (the "License");
 * you may not use this file except in compliance with the License.
 * You may obtain a copy of the License at
 *
 *     http://www.apache.org/licenses/LICENSE-2.0
 *
 * Unless required by applicable law or agreed to in writing, software
 * distributed under the License is distributed on an "AS IS" BASIS,
 * WITHOUT WARRANTIES OR CONDITIONS OF ANY KIND, either express or implied.
 * See the License for the specific language governing permissions and
 * limitations under the License.
 */

#include "main_functions.h"

/* Increase number of loops to see full period of the sine curve */
#define NUM_LOOPS 10

/* This is the default main used on systems that have the standard C entry
 * point. Other devices (for example FreeRTOS or ESP32) that have different
 * requirements for entry code (like an app_main function) should specialize
 * this main.cc file in a target-specific subfolder.
 */
int main(int argc, char *argv[])
{
	setup();
	/* Note: Modified from original while(true) to accommodate CI */
	while (1) {
		loop();
	}
	return 0;
}
```

## src/main_functions.cpp
```c
/*
 * Copyright 2020 The TensorFlow Authors. All Rights Reserved.
 *
 * Licensed under the Apache License, Version 2.0 (the "License");
 * you may not use this file except in compliance with the License.
 * You may obtain a copy of the License at
 *
 *     http://www.apache.org/licenses/LICENSE-2.0
 *
 * Unless required by applicable law or agreed to in writing, software
 * distributed under the License is distributed on an "AS IS" BASIS,
 * WITHOUT WARRANTIES OR CONDITIONS OF ANY KIND, either express or implied.
 * See the License for the specific language governing permissions and
 * limitations under the License.
 *
 * Copyright (c) 2025 Aerlync Labs Inc.
 */

#include "main_functions.h"

#include <tensorflow/lite/micro/micro_mutable_op_resolver.h>
#include "constants.h"
#include "model.hpp"
#include "output_handler.hpp"
#include <tensorflow/lite/micro/micro_log.h>
#include <tensorflow/lite/micro/micro_interpreter.h>
#include <tensorflow/lite/micro/system_setup.h>
#include <tensorflow/lite/schema/schema_generated.h>
#include <zephyr/kernel.h>

/* Globals, used for compatibility with Arduino-style sketches. */
namespace {
	const tflite::Model *model = nullptr;
	tflite::MicroInterpreter *interpreter = nullptr;
	TfLiteTensor *input = nullptr;
	TfLiteTensor *output = nullptr;
	int inference_count = 0;

	constexpr int kTensorArenaSize = 2000;
	uint8_t tensor_arena[kTensorArenaSize];
}  /* namespace */

/* The name of this function is important for Arduino compatibility. */
void setup(void)
{
	/* Map the model into a usable data structure. This doesn't involve any
	 * copying or parsing, it's a very lightweight operation.
	 */
	model = tflite::GetModel(g_model);
	if (model->version() != TFLITE_SCHEMA_VERSION) {
		MicroPrintf("Model provided is schema version %d not equal "
					"to supported version %d.",
					model->version(), TFLITE_SCHEMA_VERSION);
		return;
	}

	/* This pulls in the operation implementations we need.
	 * NOLINTNEXTLINE(runtime-global-variables)
	 */
	static tflite::MicroMutableOpResolver <1> resolver;
	resolver.AddFullyConnected();

	/* Build an interpreter to run the model with. */
	static tflite::MicroInterpreter static_interpreter(
		model, resolver, tensor_arena, kTensorArenaSize);
	interpreter = &static_interpreter;

	/* Allocate memory from the tensor_arena for the model's tensors. */
	TfLiteStatus allocate_status = interpreter->AllocateTensors();
	if (allocate_status != kTfLiteOk) {
		MicroPrintf("AllocateTensors() failed");
		return;
	}

	/* Obtain pointers to the model's input and output tensors. */
	input = interpreter->input(0);
	output = interpreter->output(0);

	/* Report how much of the tensor arena the model actually needs. */
	MicroPrintf("Tensor arena: %u of %d bytes used",
		    (unsigned)interpreter->arena_used_bytes(), kTensorArenaSize);

	/* Benchmark: average the cost of one inference over many runs. */
	constexpr int kBenchRuns = 1000;
	input->data.int8[0] = 0;
	uint32_t start = k_cycle_get_32();
	for (int i = 0; i < kBenchRuns; i++) {
		interpreter->Invoke();
	}
	uint32_t cycles = k_cycle_get_32() - start;
	MicroPrintf("Benchmark: %d inferences, avg %u cycles = %u ns each (CPU %u MHz)",
		    kBenchRuns, cycles / kBenchRuns,
		    (unsigned)(k_cyc_to_ns_floor64(cycles) / kBenchRuns),
		    sys_clock_hw_cycles_per_sec() / 1000000);

	HandleOutputInit();

	/* Keep track of how many inferences we have performed. */
	inference_count = 0;
}

/* The name of this function is important for Arduino compatibility. */
void loop(void)
{
	/* Calculate an x value to feed into the model. We compare the current
	 * inference_count to the number of inferences per cycle to determine
	 * our position within the range of possible x values the model was
	 * trained on, and use this to calculate a value.
	 */
	float position = static_cast < float > (inference_count) /
			 static_cast < float > (kInferencesPerCycle);
	float x = position * kXrange;

	/* Quantize the input from floating-point to integer */
	int8_t x_quantized = (int8_t)round(x / input->params.scale)
		             + input->params.zero_point;
	/* Place the quantized input in the model's input tensor */
	input->data.int8[0] = x_quantized;

	/* Run inference, and report any error */
	uint32_t start = k_cycle_get_32();
	TfLiteStatus invoke_status = interpreter->Invoke();
	uint32_t cycles = k_cycle_get_32() - start;
	if (invoke_status != kTfLiteOk) {
		MicroPrintf("Invoke failed on x: %f\n", static_cast < double > (x));
		return;
	}

	/* Obtain the quantized output from model's output tensor */
	int8_t y_quantized = output->data.int8[0];
	/* Dequantize the output from integer to floating-point */
	float y = (y_quantized - output->params.zero_point) * output->params.scale;

	/* Output the results. A custom HandleOutput function can be implemented
	 * for each supported hardware target.
	 */
	HandleOutput(x, y, cycles);

	/* Increment the inference_counter, and reset it if we have reached
	 * the total number per cycle
	 */
	inference_count += 1;
	if (inference_count >= kInferencesPerCycle) inference_count = 0;
}
```

## src/output_handler.cpp
```c
/*
 * Copyright 2020 The TensorFlow Authors. All Rights Reserved.
 *
 * Licensed under the Apache License, Version 2.0 (the "License");
 * you may not use this file except in compliance with the License.
 * You may obtain a copy of the License at
 *
 *     http://www.apache.org/licenses/LICENSE-2.0
 *
 * Unless required by applicable law or agreed to in writing, software
 * distributed under the License is distributed on an "AS IS" BASIS,
 * WITHOUT WARRANTIES OR CONDITIONS OF ANY KIND, either express or implied.
 * See the License for the specific language governing permissions and
 * limitations under the License.
 */

#include "output_handler.hpp"

#include <zephyr/kernel.h>
#include <zephyr/drivers/gpio.h>

/* Green LED (alias led1 on FRDM-MCXN236). */
static const struct gpio_dt_spec led = GPIO_DT_SPEC_GET(DT_ALIAS(led1), gpios);

/* Each prediction is shown for this long, with software PWM at 1 kHz. */
#define SHOW_MS    50
#define PWM_PERIOD_US 1000

void HandleOutputInit(void)
{
	if (!gpio_is_ready_dt(&led) ||
	    gpio_pin_configure_dt(&led, GPIO_OUTPUT_INACTIVE) != 0) {
		MicroPrintf("LED init failed");
	}
}

void HandleOutput(float x_value, float y_value, uint32_t invoke_cycles)
{
	/* Log the current X and Y values */
	MicroPrintf("x_value: %f, y_value: %f, invoke: %u ns",
		    static_cast < double > (x_value),
		    static_cast < double > (y_value),
		    (unsigned)k_cyc_to_ns_floor64(invoke_cycles));

	/* Map y in [-1, 1] to a duty cycle in [0, 100] percent. */
	int duty = (int)((y_value + 1.0f) * 50.0f);
	duty = duty < 0 ? 0 : (duty > 100 ? 100 : duty);
	int on_us = PWM_PERIOD_US * duty / 100;

	for (int t = 0; t < SHOW_MS * 1000; t += PWM_PERIOD_US) {
		if (on_us > 0) {
			gpio_pin_set_dt(&led, 1);
			k_busy_wait(on_us);
		}
		if (on_us < PWM_PERIOD_US) {
			gpio_pin_set_dt(&led, 0);
			k_busy_wait(PWM_PERIOD_US - on_us);
		}
	}
}
```

## src/output_handler.hpp
```c
/*
 * Copyright 2020 The TensorFlow Authors. All Rights Reserved.
 *
 * Licensed under the Apache License, Version 2.0 (the "License");
 * you may not use this file except in compliance with the License.
 * You may obtain a copy of the License at
 *
 *     http://www.apache.org/licenses/LICENSE-2.0
 *
 * Unless required by applicable law or agreed to in writing, software
 * distributed under the License is distributed on an "AS IS" BASIS,
 * WITHOUT WARRANTIES OR CONDITIONS OF ANY KIND, either express or implied.
 * See the License for the specific language governing permissions and
 * limitations under the License.
 */

#ifndef TENSORFLOW_LITE_MICRO_EXAMPLES_HELLO_WORLD_OUTPUT_HANDLER_H_
#define TENSORFLOW_LITE_MICRO_EXAMPLES_HELLO_WORLD_OUTPUT_HANDLER_H_

#include <tensorflow/lite/c/common.h>
#include <tensorflow/lite/micro/micro_log.h>

/* Called by the main loop to produce some output based on the x and y values */
#include <stdint.h>

/* Configure the LED used to visualise the model output. */
void HandleOutputInit(void);

/* Print the prediction and show it as green LED brightness. */
void HandleOutput(float x_value, float y_value, uint32_t invoke_cycles);

#endif  /* TENSORFLOW_LITE_MICRO_EXAMPLES_HELLO_WORLD_OUTPUT_HANDLER_H_ */
```
